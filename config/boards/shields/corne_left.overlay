/ {
    zephyr,keyboard-matrix {
        row-gpios = <&gpio0 4 GPIO_ACTIVE_LOW>,   // Row 1
                     <&gpio0 15 GPIO_ACTIVE_LOW>, // Row 2
                     <&gpio0 9 GPIO_ACTIVE_LOW>,  // Row 3
                     <&gpio0 8 GPIO_ACTIVE_LOW>,  // Row 4
                     <&gpio0 7 GPIO_ACTIVE_LOW>;  // Row 5

        col-gpios = <&gpio0 21 GPIO_ACTIVE_LOW>,  // Col 1
                     <&gpio0 10 GPIO_ACTIVE_LOW>, // Col 2
                     <&gpio0 16 GPIO_ACTIVE_LOW>, // Col 3
                     <&gpio0 14 GPIO_ACTIVE_LOW>, // Col 4
                     <&gpio0 20 GPIO_ACTIVE_LOW>, // Col 5
                     <&gpio0 19 GPIO_ACTIVE_LOW>, // Col 6
                     <&gpio0 6 GPIO_ACTIVE_LOW>;  // Col 7
    };
};
