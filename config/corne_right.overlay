/*
 * Custom Corne Right Overlay
 * Baseado nos pinos fornecidos:
 * Colunas: P0.06, P0.07, P0.15, P0.16, P0.09, P0.14
 * Linhas: P0.05, P0.08, P0.10, P0.18, P0.19
 *
 * SPDX-License-Identifier: MIT
 */

/ {
    chosen {
        zmk,kscan = &kscan0;
        // zmk,backlight = &backlight; // Descomente se usar LEDs
        // zmk,rgb = &rgb;           // Descomente se usar LEDs
    };

    kscan0: kscan {
        compatible = "zmk,kscan-gpio-matrix";
        label = "KSCAN_0";

        // Definição dos pinos das LINHAS (ROWS) - 5 linhas
        // Use GPIO_ACTIVE_HIGH | GPIO_PULL_DOWN para rows
        row-gpios = <&gpio0 5  (GPIO_ACTIVE_HIGH | GPIO_PULL_DOWN)  // Pino 5
                     &gpio0 8  (GPIO_ACTIVE_HIGH | GPIO_PULL_DOWN)  // Pino 8
                     &gpio0 10 (GPIO_ACTIVE_HIGH | GPIO_PULL_DOWN) // Pino 10
                     &gpio0 18 (GPIO_ACTIVE_HIGH | GPIO_PULL_DOWN) // Pino 18
                     &gpio0 19 (GPIO_ACTIVE_HIGH | GPIO_PULL_DOWN) // Pino 19
                    >;

        // Definição dos pinos das COLUNAS (COLUMNS) - 6 colunas
        // Use GPIO_ACTIVE_HIGH | GPIO_PULL_UP para columns
        col-gpios = <&gpio0 6  (GPIO_ACTIVE_HIGH | GPIO_PULL_UP)  // Pino 6
                     &gpio0 7  (GPIO_ACTIVE_HIGH | GPIO_PULL_UP)  // Pino 7
                     &gpio0 15 (GPIO_ACTIVE_HIGH | GPIO_PULL_UP) // Pino 15
                     &gpio0 16 (GPIO_ACTIVE_HIGH | GPIO_PULL_UP) // Pino 16
                     &gpio0 9  (GPIO_ACTIVE_HIGH | GPIO_PULL_UP)  // Pino 9
                     &gpio0 14 (GPIO_ACTIVE_HIGH | GPIO_PULL_UP) // Pino 14
                    >;

        diode-direction = "col2row";
        // As linhas col-count e row-count devem ser REMOVIDAS daqui
        // O ZMK infere a contagem pelos gpios definidos.
    };

    // ... o resto do seu arquivo (se houver, como exemplos de RGB/Encoder comentados)
};
