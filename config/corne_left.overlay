/*
 * Custom Corne Left Overlay
 * Baseado nos pinos fornecidos:
 * Colunas: P0.21, P0.10, P0.16, P0.14, P0.20, P0.19
 * Linhas: P0.04, P0.15, P0.09, P0.08, P0.07
 *
 * SPDX-License-Identifier: MIT
 */

/ {
    chosen {
        zmk,kscan = &kscan0;
        // zmk,backlight = &backlight;
        // zmk,rgb = &rgb;
    };

    kscan0: kscan {
        compatible = "zmk,kscan-gpio-matrix";
        label = "KSCAN_0"; // Nota: o warning 'label' is marked as deprecated' pode ser ignorado por enquanto.

        // Definição dos pinos das LINHAS (ROWS) - 5 linhas
        // Use GPIO_ACTIVE_HIGH | GPIO_PULL_DOWN para rows
        row-gpios = <&gpio0 4  (GPIO_ACTIVE_HIGH | GPIO_PULL_DOWN) // Pino 4
                     &gpio0 15 (GPIO_ACTIVE_HIGH | GPIO_PULL_DOWN) // Pino 15
                     &gpio0 9  (GPIO_ACTIVE_HIGH | GPIO_PULL_DOWN) // Pino 9
                     &gpio0 8  (GPIO_ACTIVE_HIGH | GPIO_PULL_DOWN) // Pino 8
                     &gpio0 7  (GPIO_ACTIVE_HIGH | GPIO_PULL_DOWN) // Pino 7
                    >;

        // Definição dos pinos das COLUNAS (COLUMNS) - 6 colunas
        // Use GPIO_ACTIVE_HIGH | GPIO_PULL_UP para columns
        col-gpios = <&gpio0 21 (GPIO_ACTIVE_HIGH | GPIO_PULL_UP) // Pino 21
                     &gpio0 10 (GPIO_ACTIVE_HIGH | GPIO_PULL_UP) // Pino 10
                     &gpio0 16 (GPIO_ACTIVE_HIGH | GPIO_PULL_UP) // Pino 16
                     &gpio0 14 (GPIO_ACTIVE_HIGH | GPIO_PULL_UP) // Pino 14
                     &gpio0 20 (GPIO_ACTIVE_HIGH | GPIO_PULL_UP) // Pino 20
                     &gpio0 19 (GPIO_ACTIVE_HIGH | GPIO_PULL_UP) // Pino 19
                    >;

        diode-direction = "col2row";
        // --- REMOVA AS DUAS LINHAS ABAIXO ---
        // col-count = <6>;
        // row-count = <5>;
        // -----------------------------------
    };
};
